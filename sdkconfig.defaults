## sdkconfig.defaults
```kconfig
## Ticks duration of 1000ms
CONFIG_FREERTOS_HZ=1000

## C++ exceptions enabled 
CONFIG_CXX_EXCEPTIONS=y
## Emergency pool size for exception objects
CONFIG_CXX_EXCEPTIONS_EMG_POOL_SIZE=2048
```
